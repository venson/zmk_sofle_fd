## boards/shields/sofle/sofle_right_defconfig
```kconfig
CONFIG_SERIAL=y
CONFIG_ZMK_SPLIT=y
CONFIG_CONSOLE=n

CONFIG_UART_CONSOLE=n
CONFIG_ZMK_USB=y

CONFIG_MPU_ALLOW_FLASH_WRITE=y
CONFIG_NVS=y
CONFIG_SETTINGS_NVS=y
CONFIG_FLASH=y
CONFIG_FLASH_PAGE_LAYOUT=y
CONFIG_FLASH_MAP=y
```
